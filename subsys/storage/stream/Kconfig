## subsys/storage/stream/Kconfig
```kconfig
#
# Copyright (c) 2020 Nordic Semiconductor ASA
#
# SPDX-License-Identifier: Apache-2.0
#

menuconfig STREAM_FLASH
	bool "Stream to flash"
	select FLASH_PAGE_LAYOUT
	help
	  Enable support of stream to flash API

if STREAM_FLASH

config STREAM_FLASH_ERASE
	bool "Perform erase operations"
	help
	  If disabled an external actor must erase the flash area being written
	  to.

module = STREAM_FLASH
module-str = stream flash
source "subsys/logging/Kconfig.template.log_config"

endif # STREAM_FLASH

config STREAM_FLASH_NV
	bool "Stream to flash (nonvolatile)"
	depends on SETTINGS
	depends on !SETTINGS_NONE
	help
	  Enable alternate stream to flash API which also stores the current
	  write progress to flash using the settings subsystem. In case of power
	  failure or device reset, the operation can then resume from the latest
	  state.
```
