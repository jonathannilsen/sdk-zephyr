## modules/hal_nordic/Kconfig.sysbuild
```kconfig
# Copyright (c) 2025 Nordic Semiconductor ASA
# SPDX-License-Identifier: Apache-2.0

config SYSBUILD_HAL_NORDIC_MODULE
	bool

rsource "ironside/se/Kconfig.sysbuild"
```

## modules/hal_nordic/ironside/se/Kconfig
```kconfig
# Copyright (c) 2025 Nordic Semiconductor ASA
# SPDX-License-Identifier: Apache-2.0

config HAS_IRONSIDE_SE
	bool

menu "IronSide SE"
	depends on HAS_IRONSIDE_SE

config IRONSIDE_SE_CALL
	bool "IronSide calls"
	default y
	depends on DT_HAS_NORDIC_IRONSIDE_CALL_ENABLED
	depends on MULTITHREADING
	select EVENTS
	select MBOX
	help
	  Support for IronSide call APIs.

if IRONSIDE_SE_CALL

config IRONSIDE_SE_CALL_INIT_PRIORITY
	int "IronSide calls' driver initialization priority"
	default 41
	help
	  Initialization priority of the IronSide call protocol driver.
	  It must be below MBOX_INIT_PRIORITY, but higher than the priority of any feature
	  that depends on IRONSIDE_SE_CALL.

endif # IRONSIDE_SE_CALL

config IRONSIDE_SE_DVFS
	bool "DVFS support"
	depends on SOC_NRF54H20_CPUAPP
	depends on IRONSIDE_SE_CALL
	help
	  Support for changing the DVFS operating point.

if IRONSIDE_SE_DVFS

config IRONSIDE_SE_DVFS_ABB_STATUSANA_CHECK_MAX_ATTEMPTS
	int "ABB analog status check maximum attempts"
	range 0 255
	default 50
	help
	  Maximum attempts with 10us intervals before busy status will be reported.

endif # IRONSIDE_SE_DVFS

menuconfig NRF_PERIPHCONF_SECTION
	bool "Global peripheral initialization section"
	depends on LINKER_DEVNULL_SUPPORT
	imply LINKER_DEVNULL_MEMORY
	help
	  Include static global domain peripheral initialization values from the
	  build in a dedicated section in the devnull region.

config NRF_PERIPHCONF_GENERATE_ENTRIES
	bool "Generate PERIPHCONF entries source file"
	default y
	depends on NRF_PERIPHCONF_SECTION
	help
	  Generate a C file containing PERIPHCONF entries based on the
	  device configuration in the devicetree.

config IS_IRONSIDE_SE_SECONDARY_IMAGE
	bool "Secondary image indicator (informative only, do not change)"
	help
	  This Kconfig is set by sysbuild to indicate that this image is a
	  secondary firmware for Ironside SE. This is used by the UICR generation
	  system to determine which PERIPHCONF partition to use.

config IS_GEN_UICR_IMAGE
	bool "UICR generator image indicator (informative only, do not change)"
	help
	  This Kconfig is automatically set when building the gen_uicr image.
	  It indicates that this is the UICR generator utility image and enables
	  the UICR generator configuration options.

# Source UICR generator options when building the gen_uicr image
# All options are disabled by default unless IS_GEN_UICR_IMAGE is set
rsource "Kconfig.gen_uicr"

endmenu # IronSide SE
```

## soc/nordic/nrf92/Kconfig.sysbuild
```kconfig
# Copyright (c) 2025 Nordic Semiconductor ASA
# SPDX-License-Identifier: Apache-2.0

if SOC_SERIES_NRF92X

config HAS_IRONSIDE_SE
	default y

endif

if SOC_NRF9280_CPUPPR

config HAS_NORDIC_VPR_LAUNCHER_IMAGE
	default y

endif
```
